| Generated from griffin.yml by codegen.py on 2026-03-03 — do not edit

| Project: Griffin
.equ SYSCLK, 12000000

| GLUE: System glue logic
.equ GLUE_BASE, 0xF00000
.equ GLUE_SIZE, 0x040000
.equ GLUE_DEBUG_OUT, 0xF00001  | WRITE
.equ GLUE_DEBUG_OUT_MASK,  0x01
.equ GLUE_DEBUG_OUT_SHIFT, 0
.equ GLUE_DEBUG_IN, 0xF00001  | READ
.equ GLUE_DEBUG_IN_MASK,  0x01
.equ GLUE_DEBUG_IN_SHIFT, 0
.equ GLUE_UART_TX_STATUS, 0xF00003  | READ
.equ GLUE_UART_TX_STATUS_BUSY_MASK,  0x01
.equ GLUE_UART_TX_STATUS_BUSY_SHIFT, 0
.equ GLUE_UART_TX_DATA, 0xF00003  | WRITE
.equ GLUE_UART_RX_STATUS, 0xF00005  | READ
.equ GLUE_UART_RX_STATUS_READY_MASK,  0x01
.equ GLUE_UART_RX_STATUS_READY_SHIFT, 0
.equ GLUE_UART_RX_STATUS_PIN_MASK,  0x80
.equ GLUE_UART_RX_STATUS_PIN_SHIFT, 7
.equ GLUE_UART_RX_CONFIG, 0xF00005  | WRITE
.equ GLUE_UART_RX_CONFIG_ARM_MASK,  0x01
.equ GLUE_UART_RX_CONFIG_ARM_SHIFT, 0
.equ GLUE_CONFIG, 0xF00007  | WRITE
.equ GLUE_CONFIG_ROM_OVERLAY_DISABLE_MASK,  0x01
.equ GLUE_CONFIG_ROM_OVERLAY_DISABLE_SHIFT, 0

| ROM: 2x 64K byte-wide EPROM/Flash
.equ ROM_BASE, 0xC00000
.equ ROM_SIZE, 0x020000
.equ ROM_WINDOW, 0x100000

| RAM_BANK_1: SRAM
.equ RAM_BANK_1_BASE, 0x000000
.equ RAM_BANK_1_SIZE, 0x100000

| RAM_BANK_2: SRAM
.equ RAM_BANK_2_BASE, 0x100000
.equ RAM_BANK_2_SIZE, 0x100000

| RAM_BANK_3: SRAM
.equ RAM_BANK_3_BASE, 0x200000
.equ RAM_BANK_3_SIZE, 0x100000

| RAM_BANK_4: SRAM
.equ RAM_BANK_4_BASE, 0x300000
.equ RAM_BANK_4_SIZE, 0x100000

| VIDEO: On-board video generator
.equ VIDEO_BASE, 0xE00000
.equ VIDEO_SIZE, 0x100000
.equ VIDEO_MODE, 0xE00001  | RW
.equ VIDEO_MODE_CLOCK_MASK,  0x07
.equ VIDEO_MODE_CLOCK_SHIFT, 0
.equ VIDEO_MODE_CLOCK_DISABLED, 0
.equ VIDEO_MODE_CLOCK_CLK_14MHZ, 4
.equ VIDEO_MODE_CLOCK_CLK_25MHZ, 5
.equ VIDEO_MODE_PALETTE_MASK,  0x08
.equ VIDEO_MODE_PALETTE_SHIFT, 3
.equ VIDEO_MODE_FORMAT_MASK,  0x10
.equ VIDEO_MODE_FORMAT_SHIFT, 4
.equ VIDEO_MODE_ENBVINT_MASK,  0x20
.equ VIDEO_MODE_ENBVINT_SHIFT, 5
.equ VIDEO_MODE_ENBSNP_MASK,  0x40
.equ VIDEO_MODE_ENBSNP_SHIFT, 6
.equ VIDEO_MODE_CBURST_MASK,  0x80
.equ VIDEO_MODE_CBURST_SHIFT, 7
.equ VIDEO_MODE2, 0xE00003  | RW
.equ VIDEO_MODE2_PPC_MASK,  0x01
.equ VIDEO_MODE2_PPC_SHIFT, 0
.equ VIDEO_MODE2_ENBLINT_MASK,  0x02
.equ VIDEO_MODE2_ENBLINT_SHIFT, 1
.equ VIDEO_WORDS_START, 0xE00005  | WRITE
.equ VIDEO_BORDER_PIXEL, 0xE00009  | RW
.equ VIDEO_BORDER_PIXEL_VALUE_MASK,  0x01
.equ VIDEO_BORDER_PIXEL_VALUE_SHIFT, 0
.equ VIDEO_LINES_START, 0xE0000B  | WRITE
.equ VIDEO_LINES_COUNT, 0xE0000C  | WRITE
.equ VIDEO_PALETTE, 0xE0000E  | WRITE
.equ VIDEO_PALETTE_ENTRY_0_MASK,  0xFF
.equ VIDEO_PALETTE_ENTRY_0_SHIFT, 0
.equ VIDEO_PALETTE_ENTRY_1_MASK,  0xFF00
.equ VIDEO_PALETTE_ENTRY_1_SHIFT, 8
.equ VIDEO_NEXT_PALETTE, 0xE00010  | WRITE
.equ VIDEO_NEXT_PALETTE_ENTRY_0_MASK,  0xFF
.equ VIDEO_NEXT_PALETTE_ENTRY_0_SHIFT, 0
.equ VIDEO_NEXT_PALETTE_ENTRY_1_MASK,  0xFF00
.equ VIDEO_NEXT_PALETTE_ENTRY_1_SHIFT, 8
.equ VIDEO_ARM_SNOOP, 0xE00012  | WRITE
.equ VIDEO_DISARM_SNOOP, 0xE00014  | WRITE

| ENGINE: Application-specific accelerator
.equ ENGINE_BASE, 0xD00000
.equ ENGINE_SIZE, 0x100000

| CF: Storage via CF card in True IDE 8-bit PIO mode
.equ CF_BASE, 0xF40000
.equ CF_SIZE, 0x040000
.equ CF_DATA, 0xF40001  | RW
.equ CF_ERROR, 0xF40003  | READ
.equ CF_FEATURES, 0xF40003  | WRITE
.equ CF_SECTOR_COUNT, 0xF40005  | RW
.equ CF_SECTOR_NUM, 0xF40007  | RW
.equ CF_CYL_LO, 0xF40009  | RW
.equ CF_CYL_HI, 0xF4000B  | RW
.equ CF_DRIVE_HEAD, 0xF4000D  | RW
.equ CF_STATUS, 0xF4000F  | READ
.equ CF_COMMAND, 0xF4000F  | WRITE

| IO_MCU: Keyboard, mouse, serial IO processor
.equ IO_MCU_BASE, 0xF80000
.equ IO_MCU_SIZE, 0x040000
.equ IO_MCU_STATUS, 0xF80001  | READ
.equ IO_MCU_CONFIG, 0xF80001  | WRITE
.equ IO_MCU_TX, 0xF80003  | WRITE
.equ IO_MCU_RX, 0xF80005  | READ

| AUDIO: 8-bit latched audio output
.equ AUDIO_BASE, 0xFC0000
.equ AUDIO_SIZE, 0x040000
.equ AUDIO_DAC, 0xFC0001  | WRITE

| Constants
.equ CF_STATUS_BSY, 0x80
.equ CF_STATUS_DRDY, 0x40
.equ CF_STATUS_DRQ, 0x08
.equ CF_STATUS_ERR, 0x01
.equ CF_CMD_READ_SECTORS, 0x20
.equ CF_CMD_WRITE_SECTORS, 0x30
.equ CF_CMD_IDENTIFY, 0xEC
.equ CF_CMD_SET_FEATURES, 0xEF
.equ CF_CMD_SET_8BIT, 0x01
.equ CF_DH_LBA, 0xE0

