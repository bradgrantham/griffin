| Generated from griffin.yml by codegen.py — do not edit (regenerate with: make codegen)

| Project: Griffin
.equ SYSCLK_HZ, 14000000

| GLUE: System glue logic (also hosts PS/2 keyboard RX/TX)
.equ GLUE_BASE, 0xF00000
.equ GLUE_SIZE, 0x040000
.equ GLUE_IRQ_LEVEL, 4
.equ GLUE_DEBUG_OUT, 0xF00001  | WRITE
.equ GLUE_DEBUG_OUT_MASK,  0x01
.equ GLUE_DEBUG_OUT_SHIFT, 0
.equ GLUE_CONFIG, 0xF00007  | WRITE
.equ GLUE_CONFIG_ROM_OVERLAY_DISABLE_MASK,  0x01
.equ GLUE_CONFIG_ROM_OVERLAY_DISABLE_SHIFT, 0
.equ GLUE_CONFIG_FLASH_WE_EN_MASK,  0x02
.equ GLUE_CONFIG_FLASH_WE_EN_SHIFT, 1
.equ GLUE_CONFIG_VSYNC_IRQ_EN_MASK,  0x04
.equ GLUE_CONFIG_VSYNC_IRQ_EN_SHIFT, 2
.equ GLUE_CONFIG_DEFAULT, 0x00
.equ GLUE_PS2_TX_DATA, 0xF00009  | WRITE
.equ GLUE_PS2_TX_DATA_MASK,  0xFF
.equ GLUE_PS2_TX_DATA_SHIFT, 0
.equ GLUE_PS2_STATUS, 0xF00011  | READ
.equ GLUE_PS2_STATUS_RX_READY_MASK,  0x01
.equ GLUE_PS2_STATUS_RX_READY_SHIFT, 0
.equ GLUE_PS2_STATUS_TX_DONE_MASK,  0x02
.equ GLUE_PS2_STATUS_TX_DONE_SHIFT, 1
.equ GLUE_PS2_STATUS_TX_ACK_MASK,  0x04
.equ GLUE_PS2_STATUS_TX_ACK_SHIFT, 2
.equ GLUE_PS2_STATUS_RX_PARITY_MASK,  0x08
.equ GLUE_PS2_STATUS_RX_PARITY_SHIFT, 3
.equ GLUE_PS2_STATUS_RX_FRAME_ERR_MASK,  0x10
.equ GLUE_PS2_STATUS_RX_FRAME_ERR_SHIFT, 4
.equ GLUE_PS2_STATUS_DATA_LIVE_MASK,  0x20
.equ GLUE_PS2_STATUS_DATA_LIVE_SHIFT, 5
.equ GLUE_PS2_STATUS_CLK_LIVE_MASK,  0x40
.equ GLUE_PS2_STATUS_CLK_LIVE_SHIFT, 6
.equ GLUE_PS2_CLEAR, 0xF00011  | WRITE
.equ GLUE_PS2_CLEAR_RX_READY_MASK,  0x01
.equ GLUE_PS2_CLEAR_RX_READY_SHIFT, 0
.equ GLUE_PS2_CLEAR_TX_DONE_MASK,  0x02
.equ GLUE_PS2_CLEAR_TX_DONE_SHIFT, 1
.equ GLUE_PS2_CTRL, 0xF00013  | WRITE
.equ GLUE_PS2_CTRL_CLK_MASK,  0x01
.equ GLUE_PS2_CTRL_CLK_SHIFT, 0
.equ GLUE_PS2_CTRL_DATA_MASK,  0x02
.equ GLUE_PS2_CTRL_DATA_SHIFT, 1
.equ GLUE_PS2_RX_DATA, 0xF00015  | READ
.equ GLUE_PS2_RX_DATA_MASK,  0xFF
.equ GLUE_PS2_RX_DATA_SHIFT, 0
.equ GLUE_VSYNC_STATUS, 0xF00017  | READ
.equ GLUE_VSYNC_STATUS_VSYNC_PENDING_MASK,  0x01
.equ GLUE_VSYNC_STATUS_VSYNC_PENDING_SHIFT, 0
.equ GLUE_VSYNC_CLEAR, 0xF00017  | WRITE
.equ GLUE_VSYNC_CLEAR_VSYNC_PENDING_MASK,  0x01
.equ GLUE_VSYNC_CLEAR_VSYNC_PENDING_SHIFT, 0

| ROM: 2x SST39SF040-70 (512Kx8 DIP-32 5V NOR flash, socketed; 1MB total)
.equ ROM_BASE, 0x800000
.equ ROM_SIZE, 0x100000
.equ ROM_WINDOW, 0x400000

| RAM_BANK_1: 2x AS6C4008
.equ RAM_BANK_1_BASE, 0x000000
.equ RAM_BANK_1_SIZE, 0x100000

| RAM_BANK_2: 2x AS6C4008
.equ RAM_BANK_2_BASE, 0x100000
.equ RAM_BANK_2_SIZE, 0x100000

| RAM_BANK_3: 2x AS6C4008
.equ RAM_BANK_3_BASE, 0x200000
.equ RAM_BANK_3_SIZE, 0x100000

| RAM_BANK_4: 2x AS6C4008
.equ RAM_BANK_4_BASE, 0x300000
.equ RAM_BANK_4_SIZE, 0x100000

| ENGINE: Display-list DMA engine walking 4-word descriptors from the top 64K of RAM
.equ ENGINE_BASE, 0xD00000
.equ ENGINE_SIZE, 0x100000
.equ ENGINE_IRQ_LEVEL, 3
.equ ENGINE_DESC, 0xD00002  | WRITE
.equ ENGINE_DESC_ADDR_MASK,  0x7FFF
.equ ENGINE_DESC_ADDR_SHIFT, 0
.equ ENGINE_CTRL, 0xD00005  | WRITE
.equ ENGINE_CTRL_ENABLE_MASK,  0x01
.equ ENGINE_CTRL_ENABLE_SHIFT, 0
.equ ENGINE_CTRL_DEFAULT, 0x00

| VIDEO: Freed region; rev-1 VIDEO retired in favor of TIMING+PIXEL+COMPOSITOR
.equ VIDEO_BASE, 0xE00000
.equ VIDEO_SIZE, 0x100000

| PORTS: PS/2 mouse, two joystick ports, two paddle counters, and the audio FIFO pop strobe
.equ PORTS_BASE, 0xFC0000
.equ PORTS_SIZE, 0x040000
.equ PORTS_IRQ_LEVEL, 2
.equ PORTS_JOYSTICK_PORT_1, 0xFC0001  | READ
.equ PORTS_JOYSTICK_PORT_1_UP_MASK,  0x01
.equ PORTS_JOYSTICK_PORT_1_UP_SHIFT, 0
.equ PORTS_JOYSTICK_PORT_1_DOWN_MASK,  0x02
.equ PORTS_JOYSTICK_PORT_1_DOWN_SHIFT, 1
.equ PORTS_JOYSTICK_PORT_1_LEFT_MASK,  0x04
.equ PORTS_JOYSTICK_PORT_1_LEFT_SHIFT, 2
.equ PORTS_JOYSTICK_PORT_1_RIGHT_MASK,  0x08
.equ PORTS_JOYSTICK_PORT_1_RIGHT_SHIFT, 3
.equ PORTS_JOYSTICK_PORT_1_FIRE_MASK,  0x10
.equ PORTS_JOYSTICK_PORT_1_FIRE_SHIFT, 4
.equ PORTS_JOYSTICK_PORT_1_PIN9_MASK,  0x20
.equ PORTS_JOYSTICK_PORT_1_PIN9_SHIFT, 5
.equ PORTS_JOYSTICK_PORT_1_PIN5_MASK,  0x40
.equ PORTS_JOYSTICK_PORT_1_PIN5_SHIFT, 6
.equ PORTS_JOYSTICK_PORT_2, 0xFC0003  | READ
.equ PORTS_JOYSTICK_PORT_2_UP_MASK,  0x01
.equ PORTS_JOYSTICK_PORT_2_UP_SHIFT, 0
.equ PORTS_JOYSTICK_PORT_2_DOWN_MASK,  0x02
.equ PORTS_JOYSTICK_PORT_2_DOWN_SHIFT, 1
.equ PORTS_JOYSTICK_PORT_2_LEFT_MASK,  0x04
.equ PORTS_JOYSTICK_PORT_2_LEFT_SHIFT, 2
.equ PORTS_JOYSTICK_PORT_2_RIGHT_MASK,  0x08
.equ PORTS_JOYSTICK_PORT_2_RIGHT_SHIFT, 3
.equ PORTS_JOYSTICK_PORT_2_FIRE_MASK,  0x10
.equ PORTS_JOYSTICK_PORT_2_FIRE_SHIFT, 4
.equ PORTS_JOYSTICK_PORT_2_PIN9_MASK,  0x20
.equ PORTS_JOYSTICK_PORT_2_PIN9_SHIFT, 5
.equ PORTS_JOYSTICK_PORT_2_PIN5_MASK,  0x40
.equ PORTS_JOYSTICK_PORT_2_PIN5_SHIFT, 6
.equ PORTS_PADDLE_A_COUNT, 0xFC0005  | READ
.equ PORTS_PADDLE_A_COUNT_MASK,  0xFF
.equ PORTS_PADDLE_A_COUNT_SHIFT, 0
.equ PORTS_PADDLE_B_COUNT, 0xFC0007  | READ
.equ PORTS_PADDLE_B_COUNT_MASK,  0xFF
.equ PORTS_PADDLE_B_COUNT_SHIFT, 0
.equ PORTS_PS2_MOUSE_TX_DATA, 0xFC0009  | WRITE
.equ PORTS_PS2_MOUSE_TX_DATA_MASK,  0xFF
.equ PORTS_PS2_MOUSE_TX_DATA_SHIFT, 0
.equ PORTS_PADDLE_CONTROL, 0xFC000F  | WRITE
.equ PORTS_PADDLE_CONTROL_DUMP_MASK,  0x01
.equ PORTS_PADDLE_CONTROL_DUMP_SHIFT, 0
.equ PORTS_PADDLE_CONTROL_DEFAULT, 0x00
.equ PORTS_PS2_MOUSE_STATUS, 0xFC0011  | READ
.equ PORTS_PS2_MOUSE_STATUS_RX_READY_MASK,  0x01
.equ PORTS_PS2_MOUSE_STATUS_RX_READY_SHIFT, 0
.equ PORTS_PS2_MOUSE_STATUS_TX_DONE_MASK,  0x02
.equ PORTS_PS2_MOUSE_STATUS_TX_DONE_SHIFT, 1
.equ PORTS_PS2_MOUSE_STATUS_TX_ACK_MASK,  0x04
.equ PORTS_PS2_MOUSE_STATUS_TX_ACK_SHIFT, 2
.equ PORTS_PS2_MOUSE_STATUS_RX_PARITY_MASK,  0x08
.equ PORTS_PS2_MOUSE_STATUS_RX_PARITY_SHIFT, 3
.equ PORTS_PS2_MOUSE_STATUS_RX_FRAME_ERR_MASK,  0x10
.equ PORTS_PS2_MOUSE_STATUS_RX_FRAME_ERR_SHIFT, 4
.equ PORTS_PS2_MOUSE_STATUS_DATA_LIVE_MASK,  0x20
.equ PORTS_PS2_MOUSE_STATUS_DATA_LIVE_SHIFT, 5
.equ PORTS_PS2_MOUSE_STATUS_CLK_LIVE_MASK,  0x40
.equ PORTS_PS2_MOUSE_STATUS_CLK_LIVE_SHIFT, 6
.equ PORTS_PS2_MOUSE_CLEAR, 0xFC0011  | WRITE
.equ PORTS_PS2_MOUSE_CLEAR_RX_READY_MASK,  0x01
.equ PORTS_PS2_MOUSE_CLEAR_RX_READY_SHIFT, 0
.equ PORTS_PS2_MOUSE_CLEAR_TX_DONE_MASK,  0x02
.equ PORTS_PS2_MOUSE_CLEAR_TX_DONE_SHIFT, 1
.equ PORTS_PS2_MOUSE_CTRL, 0xFC0013  | WRITE
.equ PORTS_PS2_MOUSE_CTRL_CLK_MASK,  0x01
.equ PORTS_PS2_MOUSE_CTRL_CLK_SHIFT, 0
.equ PORTS_PS2_MOUSE_CTRL_DATA_MASK,  0x02
.equ PORTS_PS2_MOUSE_CTRL_DATA_SHIFT, 1
.equ PORTS_PS2_MOUSE_RX_DATA, 0xFC0015  | READ
.equ PORTS_PS2_MOUSE_RX_DATA_MASK,  0xFF
.equ PORTS_PS2_MOUSE_RX_DATA_SHIFT, 0
.equ PORTS_AUDIO_CONTROL, 0xFC001F  | WRITE
.equ PORTS_AUDIO_CONTROL_ENABLE_MASK,  0x01
.equ PORTS_AUDIO_CONTROL_ENABLE_SHIFT, 0
.equ PORTS_AUDIO_CONTROL_CLEAR_HF_IRQ_MASK,  0x02
.equ PORTS_AUDIO_CONTROL_CLEAR_HF_IRQ_SHIFT, 1
.equ PORTS_AUDIO_CONTROL_DEFAULT, 0x00
.equ PORTS_AUDIO_STATUS, 0xFC001F  | READ
.equ PORTS_AUDIO_STATUS_HF_IRQ_MASK,  0x01
.equ PORTS_AUDIO_STATUS_HF_IRQ_SHIFT, 0
.equ PORTS_AUDIO_STATUS_HALF_FULL_MASK,  0x02
.equ PORTS_AUDIO_STATUS_HALF_FULL_SHIFT, 1
.equ PORTS_AUDIO_STATUS_ENABLE_MASK,  0x04
.equ PORTS_AUDIO_STATUS_ENABLE_SHIFT, 2

| CF: Storage via CF card in True IDE 16-bit PIO mode
.equ CF_BASE, 0xF40000
.equ CF_SIZE, 0x040000
.equ CF_DATA, 0xF40000  | RW
.equ CF_ERROR, 0xF40003  | READ
.equ CF_FEATURES, 0xF40003  | WRITE
.equ CF_SECTOR_COUNT, 0xF40005  | RW
.equ CF_SECTOR_NUM, 0xF40007  | RW
.equ CF_CYL_LO, 0xF40009  | RW
.equ CF_CYL_HI, 0xF4000B  | RW
.equ CF_DRIVE_HEAD, 0xF4000D  | RW
.equ CF_STATUS, 0xF4000F  | READ
.equ CF_COMMAND, 0xF4000F  | WRITE

| DUART: Console (Ch A) and second serial (Ch B), 100 Hz systick C/T, GP pins for flow control / DS3231 I2C
.equ DUART_BASE, 0xF80000
.equ DUART_SIZE, 0x040000
.equ DUART_IRQ_LEVEL, 5
.equ DUART_CLOCK, 3686400
.equ DUART_MR1A, 0xF80001  | RW
.equ DUART_MR2A, 0xF80001  | RW
.equ DUART_SRA, 0xF80003  | READ
.equ DUART_SRA_RXRDY_MASK,  0x01
.equ DUART_SRA_RXRDY_SHIFT, 0
.equ DUART_SRA_FFULL_MASK,  0x02
.equ DUART_SRA_FFULL_SHIFT, 1
.equ DUART_SRA_TXRDY_MASK,  0x04
.equ DUART_SRA_TXRDY_SHIFT, 2
.equ DUART_SRA_TXEMT_MASK,  0x08
.equ DUART_SRA_TXEMT_SHIFT, 3
.equ DUART_SRA_OE_MASK,  0x10
.equ DUART_SRA_OE_SHIFT, 4
.equ DUART_SRA_PE_MASK,  0x20
.equ DUART_SRA_PE_SHIFT, 5
.equ DUART_SRA_FE_MASK,  0x40
.equ DUART_SRA_FE_SHIFT, 6
.equ DUART_SRA_RB_MASK,  0x80
.equ DUART_SRA_RB_SHIFT, 7
.equ DUART_CSRA, 0xF80003  | WRITE
.equ DUART_CRA, 0xF80005  | WRITE
.equ DUART_CRA_EC_MASK,  0x03
.equ DUART_CRA_EC_SHIFT, 0
.equ DUART_CRA_TC_MASK,  0x0C
.equ DUART_CRA_TC_SHIFT, 2
.equ DUART_CRA_MC_MASK,  0x70
.equ DUART_CRA_MC_SHIFT, 4
.equ DUART_RBA, 0xF80007  | READ
.equ DUART_TBA, 0xF80007  | WRITE
.equ DUART_IPCR, 0xF80009  | READ
.equ DUART_ACR, 0xF80009  | WRITE
.equ DUART_ACR_BRG_SET_MASK,  0x80
.equ DUART_ACR_BRG_SET_SHIFT, 7
.equ DUART_ACR_CT_MODE_MASK,  0x70
.equ DUART_ACR_CT_MODE_SHIFT, 4
.equ DUART_ACR_IP3_INT_EN_MASK,  0x08
.equ DUART_ACR_IP3_INT_EN_SHIFT, 3
.equ DUART_ACR_IP2_INT_EN_MASK,  0x04
.equ DUART_ACR_IP2_INT_EN_SHIFT, 2
.equ DUART_ACR_IP1_INT_EN_MASK,  0x02
.equ DUART_ACR_IP1_INT_EN_SHIFT, 1
.equ DUART_ACR_IP0_INT_EN_MASK,  0x01
.equ DUART_ACR_IP0_INT_EN_SHIFT, 0
.equ DUART_ISR, 0xF8000B  | READ
.equ DUART_ISR_TXRDYA_MASK,  0x01
.equ DUART_ISR_TXRDYA_SHIFT, 0
.equ DUART_ISR_RXRDYA_MASK,  0x02
.equ DUART_ISR_RXRDYA_SHIFT, 1
.equ DUART_ISR_DELTA_BRKA_MASK,  0x04
.equ DUART_ISR_DELTA_BRKA_SHIFT, 2
.equ DUART_ISR_CTR_READY_MASK,  0x08
.equ DUART_ISR_CTR_READY_SHIFT, 3
.equ DUART_ISR_TXRDYB_MASK,  0x10
.equ DUART_ISR_TXRDYB_SHIFT, 4
.equ DUART_ISR_RXRDYB_MASK,  0x20
.equ DUART_ISR_RXRDYB_SHIFT, 5
.equ DUART_ISR_DELTA_BRKB_MASK,  0x40
.equ DUART_ISR_DELTA_BRKB_SHIFT, 6
.equ DUART_ISR_IPC_MASK,  0x80
.equ DUART_ISR_IPC_SHIFT, 7
.equ DUART_IMR, 0xF8000B  | WRITE
.equ DUART_CUR, 0xF8000D  | READ
.equ DUART_CTUR, 0xF8000D  | WRITE
.equ DUART_CLR, 0xF8000F  | READ
.equ DUART_CTLR, 0xF8000F  | WRITE
.equ DUART_MR1B, 0xF80011  | RW
.equ DUART_MR2B, 0xF80011  | RW
.equ DUART_SRB, 0xF80013  | READ
.equ DUART_CSRB, 0xF80013  | WRITE
.equ DUART_CRB, 0xF80015  | WRITE
.equ DUART_RBB, 0xF80017  | READ
.equ DUART_TBB, 0xF80017  | WRITE
.equ DUART_IVR, 0xF80019  | RW
.equ DUART_IP, 0xF8001B  | READ
.equ DUART_OPCR, 0xF8001B  | WRITE
.equ DUART_STARTCC, 0xF8001D  | READ
.equ DUART_OPR_SET, 0xF8001D  | WRITE
.equ DUART_STOPCC, 0xF8001F  | READ
.equ DUART_OPR_CLR, 0xF8001F  | WRITE

| AUDIO: Stereo FIFO audio output, drained at half the VGA line rate by PORTS
.equ AUDIO_BASE, 0xC00000
.equ AUDIO_SIZE, 0x040000
.equ AUDIO_FIFO, 0xC00000  | WRITE

| RAM region — total of all RAM banks
.equ RAM_TOTAL_SIZE, 0x400000

| Constants
.equ CF_STATUS_BSY, 0x80
.equ CF_STATUS_DRDY, 0x40
.equ CF_STATUS_DRQ, 0x08
.equ CF_STATUS_ERR, 0x01
.equ CF_CMD_READ_SECTORS, 0x20
.equ CF_CMD_WRITE_SECTORS, 0x30
.equ CF_CMD_IDENTIFY, 0xEC
.equ CF_CMD_SET_FEATURES, 0xEF
.equ CF_CMD_SET_8BIT, 0x01
.equ CF_DH_LBA, 0xE0
.equ PS2_RX_QUEUE_SIZE, 0x40
.equ AUDIO_FIFO_DEPTH, 0x100
.equ AUDIO_SAMPLES_PER_SECOND, 0x3D76
.equ DUART_OP_RTC_SCL, 0x04
.equ DUART_OP_RTC_SDA_DRIVE, 0x08
.equ DUART_IP_RTC_SDA, 0x04
.equ DUART_IP_RTC_NINT, 0x08
.equ RTC_I2C_ADDR, 0x68
.equ PS2_TX_DATA_PARITY, 0x02
.equ ENGINE_WORDS_PER_BURST, 0x14
.equ VIDEO_PIXEL_BYTES_PER_LINE, 0x50
.equ VIDEO_LINE_PIXEL_OFFSET, 0x04
.equ VIDEO_LINE_STRIDE_BYTES, 0x54
.equ VSYNC_IRQ_LEVEL, 0x06
.equ ENGINE_SIGNAL_PIXELS_FIFO_W, 0x01
.equ ENGINE_SIGNAL_VIDCMD_FIFO_W, 0x02
.equ ENGINE_SIGNAL_AUDIO_FIFO_W, 0x04
.equ VIDCMD_SET_CMP_HELD_FG, 0x00
.equ VIDCMD_SET_CMP_HELD_BG, 0x01
.equ VIDCMD_SET_PIX_PAL_FG, 0x02
.equ VIDCMD_SET_PIX_PAL_BG, 0x03
.equ VIDCMD_SET_PIX_HAM_HELD, 0x04
.equ VIDCMD_SET_PIX_MODE, 0x05
.equ VIDCMD_SET_PIX_PIXEL_SKIP, 0x06
.equ PIXELS_FIFO_WORDS, 0x100
.equ VIDCMD_FIFO_WORDS, 0x100
.equ PIXELS_WORDS_PER_LINE_1BPP, 0x28
.equ PIXELS_WORDS_PER_LINE_HAM, 0x50
.equ COMPOSITOR_LEAD, 0x02
.equ PIXEL_OUT_LEAD, 0x01
.equ TIMING_SPLIT_LEAD, 0x01
.equ DAC_LEAD, 0x04
.equ PIXEL_PRELOAD_LEAD, 0x10

| Syscalls (TRAP-based firmware<->app ABI)
.equ SYS_TRAP, 15
.equ SYS_EXIT, 0
.equ SYS_WRITE, 1
.equ SYS_READ, 2
.equ SYS_OPEN, 3
.equ SYS_CLOSE, 4
.equ SYS_LSEEK, 5
.equ SYS_FSTAT, 6
.equ SYS_ISATTY, 7
.equ SYS_STAT, 8
.equ SYS_INPUTREADY, 9
.equ SYS_READDIR, 10
.equ SYS_GETTICKS, 11
.equ SYS_GETTIME, 12
.equ SYS_VIDEO_DIRECT_START, 13
.equ SYS_VIDEO_DIRECT_END, 14

